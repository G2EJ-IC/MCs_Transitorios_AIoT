## ESP32-S3/Transitorios_AIoT_ESP32-S3/sdkconfig.defaults
```kconfig
CONFIG_PARTITION_TABLE_CUSTOM=y
CONFIG_PARTITION_TABLE_CUSTOM_FILENAME="./partitions/partitions.csv"
CONFIG_PARTITION_TABLE_OFFSET=0x8000
CONFIG_ESPTOOLPY_FLASHSIZE_4MB=y
CONFIG_LV_COLOR_DEPTH=16
CONFIG_LV_MEM_CUSTOM=y
```
